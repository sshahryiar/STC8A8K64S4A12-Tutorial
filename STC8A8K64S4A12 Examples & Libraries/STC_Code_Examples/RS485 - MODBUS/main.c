#include "STC8xxx.h"
#include "BSP.h"
#include "LCD.c"
#include "lcd_print.c"


#define DIR_RX                                  P12_low
#define DIR_TX                                  P12_high

#define TX_buffer_length                        8
#define RX_buffer_length                        10


unsigned char cnt = 0x00;
unsigned char RX_buffer[RX_buffer_length];

static const unsigned char TX_buffer[TX_buffer_length] = {0x01, 0x03, 0x00, 0x00, 0x00, 0x02, 0xC4, 0x0B};


void setup(void);
void flush_RX_buffer(void);
void send_read_command(void);
unsigned int make_word(unsigned char HB, unsigned char LB);
void get_HB_LB(unsigned int value, unsigned char *HB, unsigned char *LB);
unsigned int MODBUS_RTU_CRC16(unsigned char *data_input, unsigned char data_length);


void UART_2_ISR(void)       
interrupt 8
{
  if(check_UART_2_RX_flag)
  {
    RX_buffer[cnt++] = UART2_read_buffer();
  }
}


void main(void)
{
  unsigned int value = 0x0000;
  unsigned int CRC_check_1 = 0x0000;
  unsigned int CRC_check_2 = 0x0000;

  setup();

  LCD_goto(0, 0);
  LCD_putstr("R.H / %:");
  LCD_goto(0, 1);
  LCD_putstr("Temp/ C:");
  print_symbol(5, 1, 0);

  while(1)
  {
      send_read_command();

      CRC_check_1 = MODBUS_RTU_CRC16(RX_buffer, 7);
      CRC_check_2 = make_word(RX_buffer[8], RX_buffer[7]);

      if(CRC_check_1 == CRC_check_2)
      {
         value = make_word(RX_buffer[5], RX_buffer[6]);
         print_F(11, 0, (value / 10.0), 1);

         value = make_word(RX_buffer[3], RX_buffer[4]);
         print_F(11, 1, (value / 10.0), 1);
      }

      else
      {
        LCD_goto(12, 0);
        LCD_putstr("--.-");
        LCD_goto(12, 1);
        LCD_putstr("--.-");
      }

      P55_toggle;
      delay_ms(1000);
  };
}


void setup(void)
{
  CLK_set_sys_clk(IRC_24M, 2, MCLK_SYSCLK_no_output, MCLK_out_P54);
  
  P12_push_pull_mode;
  P55_open_drain_mode;
  
  LCD_init();
  LCD_clear_home();
  load_custom_symbol();
  
  UART2_pin_option(0x00);
  
  UART2_init(9600, \
             UART2_timer_1T, \
             12000000);
  
  _enable_UART_2_interrupt;
  _enable_global_interrupt;
}


void flush_RX_buffer(void)
{
  signed char i = (RX_buffer_length - 1);

  while(i > -1)
  {
    RX_buffer[i] = 0x00;
    i--;
  };
}


void send_read_command(void)
{
  unsigned char i = 0x00;

  flush_RX_buffer();

  DIR_TX;

  for(i = 0; i < TX_buffer_length; i++)
  {
    UART2_write_buffer(TX_buffer[i]);
  }

  cnt = 0;
  DIR_RX;

  delay_ms(600);
}


unsigned int make_word(unsigned char HB, unsigned char LB)
{
  unsigned int tmp = 0;

  tmp = HB;
  tmp <<= 8;
  tmp |= LB;

  return tmp;
}


void get_HB_LB(unsigned int value, unsigned char *HB, unsigned char *LB)
{
  *LB = (value & 0x00FF);
  *HB = ((value & 0xFF00) >> 8);
}


unsigned int MODBUS_RTU_CRC16(unsigned char *data_input, unsigned char data_length)
{
  static const unsigned int CRC_table[256] =
  {
     0x0000, 0xC0C1, 0xC181, 0x0140, 0xC301, 0x03C0, 0x0280, 0xC241,
     0xC601, 0x06C0, 0x0780, 0xC741, 0x0500, 0xC5C1, 0xC481, 0x0440,
     0xCC01, 0x0CC0, 0x0D80, 0xCD41, 0x0F00, 0xCFC1, 0xCE81, 0x0E40,
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     0x8201, 0x42C0, 0x4380, 0x8341, 0x4100, 0x81C1, 0x8081, 0x4040
   };

  unsigned char temp = 0;
  unsigned int CRC_word = 0xFFFF;

  while(data_length--)
  {
      temp = *data_input++ ^ CRC_word;
      CRC_word >>= 8;
      CRC_word ^= CRC_table[temp];
  }

  return CRC_word;
}
